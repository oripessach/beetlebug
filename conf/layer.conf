## conf/layer.conf
```bitbake
# We have a conf and classes directory, add to BBPATH
BBPATH .= ":${LAYERDIR}"

# We have recipes-* directories, add to BBFILES
BBFILES += "${LAYERDIR}/recipes-*/*/*.bb \
            ${LAYERDIR}/recipes-*/*/*.bbappend"

BBFILE_COLLECTIONS += "beetlebug"
BBFILE_PATTERN_beetlebug = "^${LAYERDIR}/"
BBFILE_PRIORITY_beetlebug = "5"
LAYERVERSION_beetlebug = "1"
LAYERSERIES_COMPAT_beetlebug = "kirkstone"
```
